; --------------------------------------------------------------------------------
; @Title: A20-LiNova U-Boot debugging Allwinner A20
; @Description: 
;   The example is generated for A20-LiNova* boards using an ICD.
;   It will NOT run on any other board, but may be used as a template
;   for others.
; @Keywords: uboot, Allwinner, a20*, A20*
; @Author: Giulio Benetti
; @Board: A20-LiNova*
; @Chip: A20*
; @Copyright: (C) 1989-2015 Lauterbach GmbH, licensed for use with TRACE32(R) only
; --------------------------------------------------------------------------------
; $Id: a20_linova_uboot.cmm

LOCAL &uboot_path

&uboot_path="/home/giuliobenetti/git/micronova/sunxi/uboot-build-s027_3"
&dtbo_path="/home/giuliobenetti/git/micronova/sunxi/output-q027_2/images"

; Debugger Reset
WinPAGE.RESet
AREA.RESet
WinPOS 0. 25. 75. 9. 0. 0. W000
AREA.view
 
PRINT "resetting..."

RESet
SYStem.CPU CortexA7MPCore
SYStem.CONFIG CoreNumber 1.
CORE.ASSIGN 1.

SYSTEM.RESETOUT 	; hard reset
SYStem.JTAGCLOCK 20MHz

SYStem.CONFIG MEMORYACCESSPORT 0.
SYStem.CONFIG DEBUGACCESSPORT 1.
SYStem.CONFIG COREBASE              0x80110000
SYStem.CONFIG BMCBASE               0x80111000
SYStem.Option DACR ON          ; give Debugger global write permissions
TrOnchip.Set DABORT OFF        ; used by Linux for page miss!
TrOnchip.Set PABORT OFF        ; used by Linux for page miss!
TrOnchip.Set UNDEF OFF         ; my be used by Linux for FPU detection
SYStem.Option MMUSPACES OFF    ; enable space ids to virtual addresses
SYStem.Option EnReset OFF
system.option.IMASKHLL ON

; Allwinner A20 Details
MAP.BONCHIP 0xffff0000--0xffff7fff
Break.Implementation Program Onchip

SYStem.Up

SETUP.IMASKASM ON          ; lock interrupts while single stepping

;load spl in sram
data.load.auto &uboot_path/spl/u-boot-spl
; start and wait for spl to be executed and fail on sd-card boot
; (because there's no sd-card inserted)
go
wait 1s
break
data.load.binary &uboot_path/u-boot.bin 0x4a000000

; Load DTB
;PRINT "loading DTB..."
;Data.LOAD.Binary &dtbo_path/sun7i-a20-q027_2.dtb 0x43000000 /NoClear
;PRINT "loading DTB Overlay..."
;Data.LOAD.Binary &dtbo_path/ctp-ft.dtb 0x43c00000 /NoClear
;PRINT "apply DTB Overlay..."

; load real u-boot into dram
data.load.auto &uboot_path/u-boot /nocode /noreg; uncomment this to debug before relocation

Register.Init
r.s pc 0x4a000000

b.s relocate_done

go

;enddo

data.load.elf &uboot_path/u-boot 0x14F8C000 /nocode /noreg

list.auto

enddo